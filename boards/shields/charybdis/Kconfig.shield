## boards/shields/charybdis/Kconfig.shield
```kconfig
config SHIELD_CHARYBDIS_DONGLE
	def_bool $(shields_list_contains,charybdis_dongle)

config SHIELD_CHARYBDIS_LEFT
	def_bool $(shields_list_contains,charybdis_left)

config SHIELD_CHARYBDIS_RIGHT
	def_bool $(shields_list_contains,charybdis_right)

config SHIELD_ERGODOX_LEFT
	def_bool $(shields_list_contains,ergodox_left)

config SHIELD_ERGODOX_RIGHT
	def_bool $(shields_list_contains,ergodox_right)
```

## config/west.yml
```yaml
manifest:
  remotes:
  - name: zmkfirmware
    url-base: https://github.com/zmkfirmware
  - name: badjeff
    url-base: https://github.com/badjeff
  - name: itslijohnny
    url-base: https://github.com/itslijohnny
  projects:
  - name: zmk
    remote: zmkfirmware
    revision: main
    import: app/west.yml
  - name: zmk-pmw3610-driver
    remote: badjeff
    revision: main
  - name: zmk-dongle-display
    remote: itslijohnny
    revision: main
  self:
    path: config
```
